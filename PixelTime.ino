#include <TimeLib.h>
#include <Ticker.h>
#include <EEPROM.h>
#include <ESP8266WiFi.h>
#include <WiFiClient.h>
#include <time.h>

#include <ESP8266HTTPClient.h>
#include <ESP8266WebServer.h>
#include <ESP8266mDNS.h>
#include <ArduinoOTA.h>
#include <ArduinoJson.h>
#include <NtpClientLib.h>
#include <P10_matrix.h>
#include <Fonts/TomThumb.h>

#define logging 0


MDNSResponder mdns;
ESP8266WebServer server(80);
Ticker display_ticker;

int brightness=0;
int dimm=0;


// Pins for LED MATRIX
#define P_LAT 16
#define P_A 5
#define P_B 4
#define P_C 15
#define P_OE 2
P10_MATRIX display( P_LAT, P_OE,P_A,P_B,P_C);

// Some standard colors
uint16_t myRED = display.color565(255, 0, 0);
uint16_t myGREEN = display.color565(0, 255, 0);
uint16_t myBLUE = display.color565(0, 0, 255);
uint16_t myWHITE = display.color565(255, 255, 255);
uint16_t myYELLOW = display.color565(255, 255, 0);
uint16_t myCYAN = display.color565(0, 255, 255);
uint16_t myMAGENTA = display.color565(255, 0, 255);
uint16_t myBLACK = display.color565(0, 0, 0);

uint16 myCOLORS[8]={myRED,myGREEN,myBLUE,myWHITE,myYELLOW,myCYAN,myMAGENTA,myBLACK};

// Array that keeps low/high temperatures and icons for two days
int    temperature_show_low[2];
int    temperature_show_high[2];
int    icon_show_low[2];
int    icon_show_high[2];

uint8_t weather_icons_a[]={0x00,0x00,0x00,0x00,0x00,0x00,0x00,0x20,0x00,0x00,0x00,0x00,0x00,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0x00
,0x00,0x00,0x00,0x00,0x00,0x00,0x00,0x00,0xff,0xe0,0x00,0x00,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0x00
,0x00,0x00,0x00,0x00,0xff,0xe0,0x00,0x00,0x00,0x00,0x00,0x00,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0x00
,0x00,0x20,0x00,0x00,0x00,0x00,0xff,0xe0,0xff,0xe0,0xff,0xe0,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0x00
,0x00,0x00,0xff,0xe0,0x00,0x00,0xff,0xe0,0xff,0xe0,0xff,0xe0,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0x00
,0x00,0x00,0x00,0x00,0x00,0x00,0xff,0xe0,0xff,0xe0,0xff,0xe0,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0x00
,0x00,0x00,0x00,0x00,0xff,0xe0,0x00,0x00,0x00,0x00,0x00,0x00,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0x00
,0x00,0x00,0x00,0x00,0x00,0x00,0x00,0x00,0xff,0xe0,0x00,0x00,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0x00
,0x00,0x00,0x00,0x00,0x00,0x00,0x00,0x00,0x00,0x00,0x00,0x00,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0x00
,0x00,0x00,0x00,0x00,0x00,0x00,0x00,0x00,0x00,0x00,0x00,0x00,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0x00
};

uint8_t weather_icons_b[]={0x00,0x00,0x00,0x00,0x00,0x20,0x00,0x00,0xff,0xe0,0x00,0x00,0x00,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0x00
,0x00,0x00,0xff,0xe0,0x00,0x00,0x00,0x00,0x00,0x00,0x00,0x00,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0x00
,0x00,0x20,0x00,0x00,0x00,0x00,0xff,0xe0,0xff,0xe0,0xff,0xe0,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0x00
,0x00,0x00,0x00,0x00,0xff,0xe0,0xff,0xe0,0xff,0xe0,0xff,0xe0,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0x00
,0xff,0xe0,0x00,0x00,0xff,0xe0,0xff,0xe0,0xff,0xe0,0xff,0xe0,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0x00
,0x00,0x00,0x00,0x00,0xff,0xe0,0xff,0xe0,0xff,0xe0,0xff,0xe0,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0x00
,0x00,0x00,0x00,0x00,0x00,0x00,0xff,0xe0,0xff,0xe0,0xff,0xe0,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0x00
,0x00,0x00,0xff,0xe0,0x00,0x00,0x00,0x00,0x00,0x00,0x00,0x00,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0x00
,0x00,0x00,0x00,0x00,0x00,0x00,0x00,0x00,0xff,0xe0,0x00,0x00,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0x20
,0x00,0x00,0x00,0x00,0x00,0x00,0x00,0x00,0x00,0x00,0x00,0x00,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0x00
};

unsigned long next_weather_update=0;
bool weather_get_error;
int sunset;

boolean syncEventTriggered = false; // True if a time even has been triggered
NTPSyncEvent_t ntpEvent; // Last triggered event

const char INDEX_HTML[] =
"<!DOCTYPE HTML>"
"<html>"
"<head>"
"<meta name = \"viewport\" content = \"width = device-width, initial-scale = 1.0, maximum-scale = 1.0, user-scalable=0\">"
"<title>ESP8266 Web Form Demo</title>"
"<style>"
"\"body { background-color: #808080; font-family: Arial, Helvetica, Sans-Serif; Color: #000000; }\""
"</style>"
"</head>"
"<body>"
"<h1>Pixel Time - Setup</h1>"
"<FORM action=\"/\" method=\"post\">"
"<label for=\"vname\">Network (ESSID): "
"<input type=\"text\" id=\"essid\" name=\"essid\">"
"</label><br>"
"<label for=\"zname\">Network key (password): "
"<input id=\"key\" name=\"key\">"
"</label><br>"
"<label for=\"ntp\">NTP server: "
"<input id=\"ntp\" name=\"ntp\" value=\"pool.ntp.org\">"
"</label><br>"
"<INPUT type=\"submit\" value=\"OK\">"
"</FORM>"
"</body>"
"</html>";

// This gets all the weather data from openweathermap
bool update_weather()
{
  dimm=-1;

  while (brightness>0)
    yield();

  display_ticker.detach();



  String response;

  // Fetch current day - only sunset time information used for now
  HTTPClient http;
  http.begin("http://api.openweathermap.org/data/2.5/weather?q=Berlin,DE&APPID=sfsdfdsfsdfsdfsdfdsdfssdf"); //HTTP
  int httpCode = http.GET();
  if(httpCode > 0) {
    // HTTP header has been send and Server response header has been handled
    Serial.printf("[HTTP] GET... code: %d\n", httpCode);

    if(httpCode == HTTP_CODE_OK) {
      response=http.getString();
      int this_index = response.indexOf("sunset");
      this_index = response.indexOf(":",this_index);
      int next_index = response.indexOf(",",this_index);
      sunset=response.substring(this_index+1,next_index).toInt();

      //Serial.println(response);
      time_t time_now = now();
      #ifdef logging
      Serial.println("Got Sunrise at " + String (sunset) + " Now:" + String (time_now));
      #endif
    }
  } else {
    weather_get_error=true;
    Serial.printf("[HTTP] GET... failed, error: %s\n", http.errorToString(httpCode).c_str());

  }
  http.end();

  // Fetch forecast
  HTTPClient http2;

  http2.begin("http://api.openweathermap.org/data/2.5/forecast?q=Berlin,DE&APPID=asdsadsadasdasdadssadsda"); //HTTP
  int httpCode2 = http2.GET();

  // httpCode will be negative on error
  if(httpCode2 > 0) {
    // HTTP header has been send and Server response header has been handled
    Serial.printf("[HTTP] GET... code: %d\n", httpCode2);

    // file found at server
    if(httpCode2 == HTTP_CODE_OK) {
      response=http2.getString();

      weather_get_error=false;
      #ifdef logging
      Serial.println("Weather data received");
      #endif
      http2.end();

    }

  } else {
    weather_get_error=true;
    Serial.printf("[HTTP] GET... failed, error: %s\n", http2.errorToString(httpCode2).c_str());

    // If is this the first fetch and it fails we show zeros
    if (temperature_show_low[0]>90)
    {
      temperature_show_low[0]=0;
      temperature_show_low[1]=0;

      temperature_show_high[0]=0;
      temperature_show_high[1]=0;

      icon_show_low[0]=1;
      icon_show_low[1]=1;

      icon_show_high[0]=1;
      icon_show_high[1]=1;

    }
    http2.end();
    display_ticker.attach(0.001, display_updater);

    dimm=1;
    return false;
  }

  // Ok ... we have some valid response data to work on

  // First day
  int last_index = response.lastIndexOf("dt\"");
  int this_index = response.indexOf("dt\"");
  int next_index =0;
  int day_index=0;

  // Fill high/low with dummy data
  temperature_show_low[0]=+99;
  temperature_show_low[1]=+99;

  temperature_show_high[0]=-99;
  temperature_show_high[1]=-99;

  icon_show_low[0]=-99;
  icon_show_low[1]=-99;

  icon_show_high[0]=+99;
  icon_show_high[1]=+99;

  // Loop over list to find the high/low weather data for today and tomorrow
  int loop_count=-1;
  while (this_index>0)
  {
    loop_count++;

    // Get time of data set
    this_index = response.indexOf(":",this_index);
    String time_stamp = response.substring(this_index+1,this_index+11);
    int time_stamp_int = time_stamp.toInt();
    int time_stamp_hour = hour(time_stamp_int);

    // Get temperature of data set
    this_index = response.indexOf("temp\"",this_index);
    this_index = response.indexOf(":",this_index);
    next_index = response.indexOf(",",this_index);

    String temperature = response.substring(this_index+1,next_index);
    int temperature_int = temperature.toInt()-273;

    // Get icon of data set
    this_index = response.indexOf("icon\"",this_index);
    this_index = response.indexOf(":",this_index);
    next_index = response.indexOf("\"",this_index+2);

    String icon = response.substring(this_index+2,next_index-1);
    String night_day = response.substring(next_index-1,next_index);
    int icon_int = icon.toInt();

    // Map fetched icon data to display icon
    switch (icon_int) {
      case 1:
      //do something when var equals 1
      icon_int=0;
      break;
      case 2:
      icon_int=1;
      //do something when var equals 2
      break;
      case 3:
      icon_int=2;
      //do something when var equals 2
      break;
      case 4:
      icon_int=3;
      //do something when var equals 2
      break;
      case 9:
      icon_int=5;
      //do something when var equals 2
      break;
      case 10:
      icon_int=4;
      //do something when var equals 2
      break;
      case 11:
      icon_int=6;
      //do something when var equals 2
      break;
      case 13:
      icon_int=7;
      //do something when var equals 2
      break;
      case 50:
      icon_int=8;
      //do something when var equals 2
      break;
      default:
      icon_int=8;
      break;
    }

    // If there is only one data-set before midnight on the current day we have to display something - just use that midgight data
    if ((time_stamp_hour==0))
    {
      if (loop_count==0)
      {
        temperature_show_low[day_index]=temperature_int;
        temperature_show_high[day_index]=temperature_int;

        icon_show_low[day_index]=icon_int;
        icon_show_high[day_index]=icon_int;
      }
      day_index++;
    }
    if (day_index==2)
    break;


    // Only use data between 6am and 6pm since we most likely will be inside otherwise
    if (((time_stamp_hour>=6)&&(time_stamp_hour<=18))||(temperature_show_low[day_index]>90)||(temperature_show_high[day_index]<-90))
    {
      #ifdef logging
      Serial.println(String(day_index) + " Temp: " + String(temperature_int)+", Icon: " + String(icon_int)+" "+String(night_day));
      #endif

      // Find the max and min over the day
      if (temperature_int<temperature_show_low[day_index])
      temperature_show_low[day_index]=temperature_int;

      if (temperature_int>temperature_show_high[day_index])
      temperature_show_high[day_index]=temperature_int;

      if (icon_int>icon_show_low[day_index])
      icon_show_low[day_index]=icon_int;

      if (icon_int<icon_show_high[day_index])
      icon_show_high[day_index]=icon_int;

    }
    this_index = response.indexOf("dt\"",this_index);

    yield();

  }

  #ifdef logging
  Serial.println("T-Low 0:" + String(temperature_show_low[0])+ ", T-High:" + String(temperature_show_high[0]));
  Serial.println("T-Low 1:" + String(temperature_show_low[1])+ ", T-High:" + String(temperature_show_high[1]));
  Serial.println("I-Low 0:" + String(icon_show_low[0])+ ", I-High:" + String(icon_show_high[0]));
  Serial.println("I-Low 1:" + String(icon_show_low[1])+ ", I-High:" + String(icon_show_high[1]));
  #endif
  display_ticker.attach(0.001, display_updater);

   dimm=1;
  return true;
}

// Handle NTP events
void processSyncEvent(NTPSyncEvent_t ntpEvent) {
  if (ntpEvent) {
    Serial.print("Time Sync error: ");
    if (ntpEvent == noResponse)
    Serial.println("NTP server not reachable");
    else if (ntpEvent == invalidAddress)
    Serial.println("Invalid NTP server address");
  }
  else {
    Serial.print("Got NTP time: ");
    Serial.println(NTP.getTimeDateString(NTP.getLastNTPSync()));
  }
}

void returnFail(String msg)
{
  server.sendHeader("Connection", "close");
  server.sendHeader("Access-Control-Allow-Origin", "*");
  server.send(500, "text/plain", msg + "\r\n");
}
bool connect_now=false;
void handleSubmit()
{
  if (!server.hasArg("essid")) return returnFail("BAD ARGS");
  String this_essid = server.arg("essid");
  String this_key = server.arg("key");
  String this_ntp = server.arg("ntp");

  Serial.println("essid: " + this_essid);
  Serial.println("key: " + this_key);
  Serial.println("ntp: " + this_ntp);
  for (int i = 0; i < 96; ++i) { EEPROM.write(i, 0); }
  for (int i = 0; i < this_essid.length(); ++i)
  EEPROM.write(i, this_essid[i]);
  for (int i = 0; i < this_key.length(); ++i)
  EEPROM.write(i+32, this_key[i]);

  for (int i = 0; i < this_ntp.length(); ++i)
  EEPROM.write(i+64, this_ntp[i]);

  EEPROM.commit();
  connect_now=true;

  server.send ( 200, "text/html", "... connecting to wifi" );
}

void handleRoot()
{
  if (server.hasArg("essid")) {
    handleSubmit();
  }
  else {
    server.send(200, "text/html", INDEX_HTML);
  }
}

void handleNotFound()
{
  String message = "File Not Found\n\n";
  message += "URI: ";
  message += server.uri();
  message += "\nMethod: ";
  message += (server.method() == HTTP_GET)?"GET":"POST";
  message += "\nArguments: ";
  message += server.args();
  message += "\n";
  for (uint8_t i=0; i<server.args(); i++){
    message += " " + server.argName(i) + ": " + server.arg(i) + "\n";
  }
  server.send(404, "text/plain", message);
}



// ISR for display refresh
void display_updater()
{

  brightness=brightness+dimm;
  if (brightness<0)
  {
    brightness=0;
    dimm=0;
  }

  if (brightness>2100)
  {
    brightness=2100;
    dimm=0;
  }
  display.display(brightness/30);
}

// Start Accespoint for entering WIFI info
void start_ap()
{
  WiFi.softAP("PixelTime", "");

  IPAddress myIP = WiFi.softAPIP();

  //WiFi.begin(ssid, password);
  Serial.println("");

  //  // Wait for connection
  //  while (WiFi.status() != WL_CONNECTED) {
  //    delay(500);
  //    Serial.print(".");
  //  }


  Serial.print("IP address: ");
  //Serial.println(WiFi.localIP());
  Serial.println( myIP);

  if (mdns.begin("esp8266WebForm", WiFi.localIP())) {
    Serial.println("MDNS responder started");
  }

  server.on("/", handleRoot);

  server.onNotFound(handleNotFound);

  server.begin();

}

void start_ota(){
  ArduinoOTA.onStart([]() {
    Serial.println("Start");
  });
  ArduinoOTA.onEnd([]() {
    Serial.println("\nEnd");
  });
  ArduinoOTA.onProgress([](unsigned int progress, unsigned int total) {
    Serial.printf("Progress: %u%%\r", (progress / (total / 100)));
  });
  ArduinoOTA.onError([](ota_error_t error) {
    Serial.printf("Error[%u]: ", error);
    if (error == OTA_AUTH_ERROR) Serial.println("Auth Failed");
    else if (error == OTA_BEGIN_ERROR) Serial.println("Begin Failed");
    else if (error == OTA_CONNECT_ERROR) Serial.println("Connect Failed");
    else if (error == OTA_RECEIVE_ERROR) Serial.println("Receive Failed");
    else if (error == OTA_END_ERROR) Serial.println("End Failed");
  });
  ArduinoOTA.begin();
}

void start_wifi()
{

  Serial.println("Reading config from EEPROM");
  String esid;
  String pass;
  String ntp;
  for (int i = 0; i < 32; ++i)
  {
    esid +=  char(EEPROM.read(i));
  }

  for (int i = 32; i < 64; ++i)
  {
    pass += char(EEPROM.read(i));
  }
  for (int i = 64; i < 96; ++i)
  {
    ntp += char(EEPROM.read(i));
  }

  esid="youressid";
  pass="yourwifikey";
  ntp="0.de.pool.ntp.org";
  Serial.println("essid: " + esid);
  Serial.println("pass: " + pass);
  Serial.println("ntp: " + ntp);
  //WiFi.mode(WIFI_OFF);
  //delay(1000);
  WiFi.mode(WIFI_STA);
  WiFi.begin(esid.c_str(), pass.c_str());
  //server.close();

  // Wait for connection
  unsigned long start_connect=millis();
  while (WiFi.status() != WL_CONNECTED) {
    delay(500);
    Serial.print(".");

    if ((millis()-start_connect)>30000)
    ESP.restart();

  }
  Serial.println(WiFi.localIP());
  NTP.onNTPSyncEvent([](NTPSyncEvent_t event) {
    ntpEvent = event;
    syncEventTriggered = true;
  });
  NTP.begin(ntp.c_str(), 1, true);
  NTP.setInterval(63);
}

void setup() {
  // put your setup code here, to run once:

  display.begin();
  display.clearDisplay();
  display.setTextColor(myCYAN);
  display.setCursor(2,0);
  display.print("Pixel");
  display.setTextColor(myMAGENTA);
  display.setCursor(2,8);
  display.print("Time");

  EEPROM.begin(512);
  Serial.begin(9600);

    start_wifi();
  start_ota();
  display_ticker.attach(0.001, display_updater);
  dimm=1;
  yield();
  delay(3000);

}

union single_double{
  uint8_t two[2];
  uint16_t one;
} this_single_double;

// This draws the weather icons and temperature
void draw_weather_icon (uint8_t icon, uint8_t location, int temp,bool ab)
{
  display.setFont(&TomThumb);

  if (location>2)
  location=2;

  if (icon>10)
  icon=10;
  for (int yy=0; yy<10;yy++)
  {
    for (int xx=0; xx<10;xx++)
    {
      uint16_t byte_pos=(xx+icon*10)*2+yy*220;
      if (ab){
        this_single_double.two[1]=weather_icons_a[byte_pos];
        this_single_double.two[0]=weather_icons_a[byte_pos+1];
      }
      else
      {
        this_single_double.two[1]=weather_icons_b[byte_pos];
        this_single_double.two[0]=weather_icons_b[byte_pos+1];
      }
      display.drawPixel(1+xx+location*12,yy,this_single_double.one);
    }

  }

  int pixel_shift=0;
  if ((temp>-10)&&(temp<10))
  pixel_shift=2;

  if (location==0)
  display.setCursor(2+pixel_shift,16);
  else
  display.setCursor(14+pixel_shift,16);

  if (temp<0)
  {
    temp=temp*-1;
    if (location==0)
    display.drawPixel(pixel_shift,13,myWHITE);
    else
    display.drawPixel(12+pixel_shift,13,myWHITE);
  }
  display.println(temp);
}

// This draws the time
void draw_time ()
{
  uint8_t this_hour= NTP.getHour();
  uint8_t this_minute= NTP.getMinute();
  uint8_t this_second= NTP.getSecond();
  display.setFont(&TomThumb);
  display.setTextColor(myWHITE);
  display.setCursor(25,6);
  if (this_hour<10)
    display.println("0"+String(this_hour));
  else
    display.println(this_hour);
  display.setCursor(25,16);

  if (this_minute<10)
    display.println("0"+String(this_minute));
  else
    display.println(this_minute);

  // Dots
  display.drawPixel(27,8,myWHITE);
  display.drawPixel(29,8,myWHITE);

}

void process_ntp()
{
  static int i = 0;
  static int last = 0;

  if (syncEventTriggered) {
    processSyncEvent(ntpEvent);
    syncEventTriggered = false;
  }

  if ((millis() - last) > 5100) {
    //Serial.println(millis() - last);
    last = millis();
#ifdef logging
    Serial.print(i); Serial.print(" ");
    Serial.print(NTP.getTimeDateString()); Serial.print(" ");
    Serial.print(NTP.isSummerTime() ? "Summer Time. " : "Winter Time. ");
    Serial.print("WiFi is ");
    Serial.print(WiFi.isConnected() ? "connected" : "not connected"); Serial.print(". ");
    Serial.print("Uptime: ");
    Serial.print(NTP.getUptimeString()); Serial.print(" since ");
    Serial.println(NTP.getTimeDateString(NTP.getFirstSync()).c_str());
#endif
    i++;
  }
}

void loop() {
  bool ret_code;
  unsigned long this_time=millis();

  // Update weather data every 10 minutes
  if (this_time>next_weather_update)
  {
    ret_code=update_weather();
    if (ret_code)
    next_weather_update=this_time+600000;
    else
    next_weather_update=this_time+5000;
  }

  display.clearDisplay();
  draw_time ();

  // Exchange sun for moon icon when past sunset
  if ((sunset<now()) && (icon_show_low[0]<2))
  icon_show_low[0]=icon_show_low[0]+9;
  if ((sunset<now()) && (icon_show_high[0]<2))
  icon_show_high[0]=icon_show_high[0]+9;

  // Flip between icons every 2 seconds to animate them a bit
  // Flip between high and lows every 5 seconds
  if ((NTP.getSecond()%20)<10)
  {
    // Dot to indicate high or low
    display.drawPixel(0,15,myWHITE);
    draw_weather_icon(icon_show_low[0],0,temperature_show_low[0],(NTP.getSecond()%4>=2));
    draw_weather_icon(icon_show_low[0],0,temperature_show_low[0],(NTP.getSecond()%4<2));
    draw_weather_icon(icon_show_low[1],1,temperature_show_low[1],(NTP.getSecond()%4>=2));
    draw_weather_icon(icon_show_low[1],1,temperature_show_low[1],(NTP.getSecond()%4<2));
  }
  else
  {
    draw_weather_icon(icon_show_high[0],0,temperature_show_high[0],(NTP.getSecond()%4>=2));
    draw_weather_icon(icon_show_high[0],0,temperature_show_high[0],(NTP.getSecond()%4<2));
    draw_weather_icon(icon_show_high[1],1,temperature_show_high[1],(NTP.getSecond()%4>=2));
    draw_weather_icon(icon_show_high[1],1,temperature_show_high[1],(NTP.getSecond()%4<2));
    // Dot to indicate high or low
    display.drawPixel(0,11,myWHITE);
  }

  // If we had problems fetching the weather we display a red dot
  if (weather_get_error)
  display.drawPixel(0,0,myRED);

  server.handleClient();
  ArduinoOTA.handle();
  process_ntp();


  delay(100);
}
